## kvcache/main/Kconfig.projbuild
```kconfig
menu "ESP32 KV Cache"

    choice KV_ENGINE
        prompt "Storage engine"
        default KV_ENGINE_OPT
        config KV_ENGINE_BASIC
            bool "basic: malloc per entry + chained hash table (textbook port)"
        config KV_ENGINE_OPT
            bool "opt: preallocated slab arena + compact open-addressing index"
        config KV_ENGINE_OPT1
            bool "opt1: the Entry 5 optimized engine, frozen for Phase 3 comparisons"
        config KV_ENGINE_OPT0
            bool "opt0: the Entry 2 optimized engine (git e82bda2), frozen"
    endchoice

    choice KV_SERVER
        prompt "Server model"
        default KV_SERVER_OPT
        config KV_SERVER_BASIC
            bool "basic: task per client, copying parser, one send() per reply"
        config KV_SERVER_OPT
            bool "opt: select() event loop, zero-copy parser, batched replies"
    endchoice

    choice KV_CORES
        prompt "Multicore model (opt server only)"
        default KV_CORES_SINGLE
        config KV_CORES_SINGLE
            bool "single: one event loop pinned to core 1 (lwIP/WiFi own core 0)"
        config KV_CORES_SINGLE_CORE0
            bool "single0: one event loop pinned to core 0 (shares core with lwIP/WiFi)"
        config KV_CORES_SHARED
            bool "shared: one loop per core, one table, one global spinlock"
        config KV_CORES_SHARDED
            bool "sharded: one loop per core, table split into 2 shards, per-shard lock"
    endchoice

    config KV_HOT_IRAM
        bool "Place hot path (hash, lookup, parser, dispatch) in IRAM"
        default y

    config KV_FORCE_LOCK
        bool "Ablation: take the shard spinlock on every op even in single-core mode"
        default n

    config KV_BASIC_FAST_ITOA
        bool "Ablation: basic engine formats GET reply headers with a hand-written itoa, not snprintf"
        default n

    config KV_PREFIX_COMPRESS
        bool "Prefix-compressed keys ('a:b:' prefixes stored once, 1-byte id per entry; opt engine)"
        default n

    config KV_ADAPTIVE_RESERVE
        bool "Adaptive heap reserve: give arena pages back when free heap < LOW, retake when > HIGH (opt engine)"
        default n
        help
            Entry 6: a reactive controller cannot absorb sudden buffer bursts, so LOW must be at least
            the largest expected burst; this then only helps with slowly changing memory demand.

    config KV_ADAPTIVE_LOW_KB
        int "Adaptive reserve: release pages below this much free heap (KB)"
        depends on KV_ADAPTIVE_RESERVE
        default 80

    config KV_ADAPTIVE_HIGH_KB
        int "Adaptive reserve: take pages back above this much free heap (KB)"
        depends on KV_ADAPTIVE_RESERVE
        default 104

    config KV_LOOPBACK_FUNCTIONAL_ONLY
        bool "Loopback test: run only the functional suite (fits the deployment heap reserve)"
        depends on KV_LOOPBACK_TEST
        default n

    config KV_MAX_CLIENTS
        int "Max concurrent clients"
        default 8

    config KV_HEAP_RESERVE_KB
        int "Heap kept free for WiFi/lwIP after the arena is carved (opt engine)"
        default 40

    config KV_RX_BUF
        int "Per-connection receive buffer (opt server)"
        default 4096

    config KV_TX_BUF
        int "Per-connection transmit buffer (opt server)"
        default 4096

    config KV_NO_WIFI
        bool "Engine-only build: never start WiFi (board power cannot sustain the radio)"
        default n

    config KV_MC_BENCH
        bool "Phase 1 multicore harness: runtime lock modes/shards, run designs at boot (opt engine)"
        depends on KV_ENGINE_OPT || KV_ENGINE_OPT1
        default n

    config KV_MC_PHASE
        int "Which harness phase to run (1 = multicore designs, 2 = load balancing + wifisim)"
        depends on KV_MC_BENCH
        default 1

    config KV_LOOPBACK_TEST
        bool "Test the real server end-to-end over lwIP loopback (127.0.0.1), no WiFi needed"
        default n

    config KV_ENGINE_TEST
        bool "Run on-board engine correctness tests at boot (WiFi off)"
        default n

    config KV_P3_BENCH
        bool "Run the Phase 3 memory benchmark at boot (WiFi off)"
        default n

    config KV_ENGINE_SELFTEST
        bool "Run on-device engine benchmark at boot (before WiFi) and print RESULT"
        default y

endmenu
```
